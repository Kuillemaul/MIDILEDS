/*
   THIS IS CREATED TO TEST THE MIDI DRUM PROJECT USING A SINGLE STRIP
   THE CODE WILL LIGHT UP SECTIONS OF THE STRIP DEPENDING ON WHAT NOT IS RECIEVED
   THE BRIGHTNESS WILL BE BASED ON VELOCITY
   THEY WILL THEN FADE OUT.

   CO. BRAD MAYZE 04/21

*/
#include <U8glib.h>
#include <U8x8lib.h>
#include <MIDI.h>  // Add Midi Library
#include <FastLED.h> // Add Fast Led

#define BASS_LEDS  10 // number of LEDS
#define BASS_LED_PIN   8
#define SNARE_LEDS  10 // number of LEDS
#define SNARE_LED_PIN   9
#define NUM_LEDS 10
#define LED_PIN 3
// ATTACHED TO PIN
//#define NUM_STRIPS 2

// Setup Button and Ecoder Pins
#define FRAMES_PER_SECOND  120
#define modeButton 2
// Rotary Encoder Inputs
#define up 6    //Next Pattern
#define down 7        //Previous Pattern
#define save 5       //No function yet


const unsigned long eventInterval = 20; // Used to fade LED
unsigned long previousTime = 0; // Used to fade LED

CRGB snareLeds[SNARE_LEDS]; //create array
CRGB bassLeds[BASS_LEDS]; //create array
CRGB leds[NUM_LEDS];
//CRGB leds[NUM_LEDS];


//Encoder settup
int currentStateCLK1;
int lastStateCLK1;
String currentDir1 = "";
unsigned long lastButtonPress1 = 0;

// GLOBAL TEMP VARIABLES
bool redraw = true;
byte color = 0;
byte speedSet = 10;
//byte fadeMode = 0;
byte padHit = 0;
byte setEdit = 0;
String padName = "none";
byte minBrightness = 255; // Seperate strip sinto sections. In future will run each pad off serperate pins.
byte brightness = 255;
// PAD ARRAYS IF RUNNING FROM SINGLE STRIP
byte bass[] = {0, 1, 2, 3, 4};
byte snare[] = {5, 6, 7, 8, 9};
byte toma[] = {10, 11, 12, 13, 15};
byte tomb[] = {16, 17, 18, 19, 20};
byte tomc[] = {21, 22, 23, 24, 25};
byte hihat[] = {26, 27, 28, 29, 30};
byte crash[] = {31, 32, 33, 34, 35};
byte ride[] = {36, 37, 38, 38, 40};

// LED DEFAULT COLORS

byte bassColor = 140;     // White?
byte snareColor = 0;      // Red
byte tomaColor = 64;      // Yellow
byte tombColor = 160;     // Blue
byte tomcColor = 96;      // Green
byte hiHatColor = 32;     // Orange
byte crashColor = 224;    // Pink
byte rideColor = 192;     // Purple

// LED DEFAULT FADE SPEED

byte bassSpeed = 20;     // White?
byte snareSpeed = 20;      // Red
byte tomaSpeed = 20;      // Yellow
byte tombSpeed = 20;     // Blue
byte tomcSpeed = 20;      // Green
byte hiHatSpeed = 20;     // Orange
byte crashSpeed = 20;    // Pink
byte rideSpeed = 20;     // Purple

volatile byte setMode = 0;

const int SCREEN_WIDTH = 128;

U8GLIB_ST7920_128X64_4X u8g(10); // create LCD
//Create an instance of the library with default name, serial port and settings
MIDI_CREATE_DEFAULT_INSTANCE();

// PICTURE CODE
const uint8_t rook_bitmap[] U8G_PROGMEM = {
  0x00, 0x00, 0x00, 0x00, 0x00, 0x00, 0x00, 0x00, 0x00, 0x00, 0x00, 0x00,
  0x00, 0x00, 0x00, 0x00, 0x00, 0x00, 0x00, 0x00, 0x00, 0x00, 0x00, 0x00,
  0x00, 0x00, 0x00, 0x00, 0x20, 0x00, 0x00, 0x00, 0x00, 0x00, 0x00, 0x08,
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  0x00, 0x00, 0x00, 0x00

};
void picture(void) {
  u8g.drawXBMP( 0, 0, 128, 64, rook_bitmap);
}




void clearLCD() {
  u8g.firstPage();
  do {
  } while ( u8g.nextPage() );
}


void setup() {
  // assign default color value
  if ( u8g.getMode() == U8G_MODE_R3G3B2 ) {
    u8g.setColorIndex(255);     // white
  }
  else if ( u8g.getMode() == U8G_MODE_GRAY2BIT ) {
    u8g.setColorIndex(3);         // max intensity
  }
  else if ( u8g.getMode() == U8G_MODE_BW ) {
    u8g.setColorIndex(1);         // pixel on
  }
  else if ( u8g.getMode() == U8G_MODE_HICOLOR ) {
    u8g.setHiColorByRGB(255, 255, 255);
  }
  Serial1.begin (115200);
  delay(2000);
  Serial1.println("Hello World");
  Serial1.println("I will now test the LEDS");
  delay(500);
  //FastLED.addLeds<WS2812B, BASS_LED_PIN, GRB>(bassLeds, BASS_LEDS);  // CREATE BASS LED STRIP
  //FastLED.addLeds<WS2812B, SNARE_LED_PIN, GRB>(snareLeds, SNARELEDS);  // CREATE SNARE LED STRIP
  FastLED.addLeds<WS2812B, BASS_LED_PIN, GRB>(bassLeds, BASS_LEDS);
  FastLED.addLeds<WS2812B, SNARE_LED_PIN, GRB>(snareLeds, SNARE_LEDS);
  FastLED.addLeds<WS2812B, LED_PIN, GRB>(leds, NUM_LEDS);

  FastLED.setBrightness(50);


  fill_solid(snareLeds, SNARE_LEDS, CRGB::Red); // TEST SNARE LED STRIP
  FastLED.show();
  delay(1000);
  fill_solid(snareLeds, SNARE_LEDS, CRGB::Black); // TEST SNARE LED STRIP
  FastLED.show();

  delay(1000);
  fill_solid(bassLeds, BASS_LEDS, CRGB::Blue); // TEST SNARE LED STRIP
  FastLED.show();
  delay(1000);
  fill_solid(bassLeds, BASS_LEDS, CRGB::Black); // TEST SNARE LED STRIP
  FastLED.show();
  delay(1000);
  fill_solid(leds, NUM_LEDS, CRGB::Green); // TEST SNARE LED STRIP
  FastLED.show();
  delay(1000);
  fill_solid(leds, NUM_LEDS, CRGB::Black);

  //  fill_solid(leds, NUM_LEDS, CRGB::Green); // TEST LED STRIP
  //  FastLED.show();
  //  delay(1000);
  //  fill_solid(leds, NUM_LEDS, CRGB::Blue); // TEST LED STRIP
  //  FastLED.show();
  //  delay(1000);
  //  fill_solid(leds, NUM_LEDS, CRGB::Black); // TEST LED STRIP
  //  FastLED.show();

  attachInterrupt(digitalPinToInterrupt(modeButton), modechange, CHANGE); // Mode Change Interrupt
  pinMode(save, INPUT_PULLUP); //Pinmode for Encoder
  pinMode(up, INPUT_PULLUP); // set pinA as an input, pulled HIGH to the logic voltage (5V or 3.3V for most cases)
  pinMode(down, INPUT_PULLUP); // set pinB as an input, pulled HIGH to the logic voltage (5V or 3.3V for most cases)
  lastStateCLK1 = digitalRead(up);

  MIDI.setHandleNoteOn(MyHandleNoteOn); // Calls when not is on
  MIDI.setHandleNoteOff(MyHandleNoteOff); // Calls when note is off (will not be used in final build)
  MIDI.begin(10); // Initialize the Midi Library on channel 10


  // END OF NEW PATTERN CODE

}
typedef void (*SimplePatternList[])();
SimplePatternList gPatterns = { rainbow, rainbowWithGlitter, confetti, sinelon, juggle, bpm };
uint8_t gCurrentPatternNumber = 0; // Index number of which pattern is current
uint8_t gHue = 0; // rotating "base color" used by many of the patterns


void loop() { // Main loop
  MIDI.read(); // Continuously check if Midi data has been received.



  if (setMode == 1) {
    editMode();
  }
  if (setEdit == 2 ) {
    colorEdit ();
  }
  if (setEdit == 3 ) {
    fade();
  }
  //if (setMode == 4 ) { // FUTURE DEVELOPMENT
  //  setMinBrightness();
  //}
  if (setMode == 2) {
    patterns();
  }

  if (redraw) {
    u8g.firstPage();
    do {
      picture();
    }
    while ( u8g.nextPage() );
    //clearLCD();
  }
  redraw = false;


  /* THIS FADES THE LED STRIP */
  unsigned long currentTime = millis();
  if (currentTime - previousTime >= snareSpeed) {
    /* Event code */
    fadeToBlackBy( snareLeds, SNARE_LEDS, 1);
    FastLED.show();


  }

  if (currentTime - previousTime >= bassSpeed) {
    /* Event code */
    fadeToBlackBy( bassLeds, BASS_LEDS, 1);
    FastLED.show();

    previousTime = currentTime;
  }
if (currentTime - previousTime >= speedSet) {
    /* Event code */
    fadeToBlackBy( leds, NUM_LEDS, 1);
    FastLED.show();


  }
}
